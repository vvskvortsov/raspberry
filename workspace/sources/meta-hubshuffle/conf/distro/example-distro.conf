## workspace/sources/meta-hubshuffle/conf/distro/example-distro.conf
```bitbake
MAINTAINER = "bub@mail.ru"

require conf/distro/poky.conf

DISTRO = "example-distro"
DISTRO_NAME = "example distro"
DISTRO_VERSION = "1.0"
DISTRO_CODENAME = "example"
SDK_VENDOR = "-exampledistro"
SDK_VERSION = "sdkversion"




#Configure package management
#point 44 45 in video uncomment next lines for work
EXTRA_IMAGE_FEATURES += "package-management "
PACKAGE_CLASSES_append = " package_ipk"
IMAGE_INSTALL_append = " opkg"
#tesk changes increments package revision
PRSERV_HOST = "localhost:0" 
PACKAGE_FEED_URIS = "http://192.168.1.69:8080"
PACKAGE_FEED_BASE_PATHS = ""
PACKAGE_FEED_ARCHS = "aarch64"  

#SET HOSTNAME
hostname_pn-base-files = "hubshuffle"


#REPLACE sysv with systemd
DISTRO_FEATURES += "systemd"
VIRTUAL-RUNTIME_init_manager = "systemd"
DISTRO_FEATURES_remove += " sysvinit"
VIRTUAL-RUNTIME_initscripts = "systemd-compat-units"
DISTRO_FEATURES_BACKFILL_CONSIDERED += "sysvinit"

#remove unneeded faetures
#DISTRO_FEATURES_remove += "bluetooth ext2"


#set defuault timezone
DEFAULT_TIMEZONE = "Europe/Moscow"
```

## workspace/sources/meta-hubshuffle/conf/machine/raspberrypi3-custom.conf
```bitbake
#@TYPE: Raspberry Pi 3 Custom Machine
#@NAME: RaspberryPi 3 Development Board - Custom machine
#@DESCRIPTION: Machine configuration for the RaspberryPi 3 in 64 bits mode

MACHINEOVERRIDES =. "raspberrypi3:"

DEFAULTTUNE ?= "cortexa7thf-neon-vfpv4"
require conf/machine/include/tune-cortexa7.inc
include conf/machine/include/rpi-base.inc

MACHINE_EXTRA_RRECOMMENDS += "\
    linux-firmware-rpidistro-bcm43430 \
    linux-firmware-rpidistro-bcm43455 \
    bluez-firmware-rpidistro-bcm43430a1-hcd \
    bluez-firmware-rpidistro-bcm4345c0-hcd \
"

SDIMG_KERNELIMAGE ?= "kernel7.img"
UBOOT_MACHINE = "rpi_3_32b_config"
SERIAL_CONSOLES ?= "115200;ttyS0"

ENABLE_UART = "1" 
UNABLE_I2C = "1"
ENABLE_SPI_BUS = "1"
GPU_MEM = "16"
DISABLE_SPLASH = "1"
DISABLE_RPI_BOOT_LOGO= "1"

KERNEL_MODULE_AUTOLOAD += "i2c-dev"
```
